/*
  SALA INTELIGENTE - Sketch FINAL completo
  Luz + Persiana (por voz/chatbot) + Piano 7 teclas (fisico) + Cuadro OLED (3 obras)
*/

#include <WiFi.h>
#include <WebServer.h>
#include <Wire.h>
#include <Adafruit_GFX.h>
#include <Adafruit_SSD1306.h>

// ---------- WIFI ----------
const char* ssid     = "Salainteligente";
const char* password = "anaescobar23";
WebServer server(80);

// ---------- PINES: LUZ Y PERSIANA ----------
const int PIN_LUZ   = 18;
const int PIN_SERVO = 19;
bool luzEncendida = false;
bool persianaAbierta = false;
const int anguloAbierta = 360;
const int anguloCerrada = 0;

// ---------- PINES: PIANO (7 teclas) ----------
const int teclas[7]         = {13, 12, 14, 27, 26, 25, 33};
const char* nombresNotas[7] = {"Do", "Re", "Mi", "Fa", "Sol", "La", "Si"};
const int notas[7]          = {262, 294, 330, 349, 392, 440, 494};
const int pinBuzzer = 4;

// ---------- OLED ----------
Adafruit_SSD1306 display(128, 64, &Wire, -1);
int cuadroActual = 0;
const int totalCuadros = 3;

// ---------- OBRA 1: Paisaje ----------
const unsigned char obra1[] PROGMEM = {
  0x00,0x00,0x00,0x00,0x00,0x00,0x00,0x00,0x00,0x00,0x00,0x00,0x00,0x00,0x00,0x00,
  0x00,0x00,0x00,0x00,0x00,0x00,0x00,0x00,0x00,0x00,0x00,0x00,0x00,0x00,0x00,0x00,
  0x00,0x00,0x00,0x00,0x00,0x00,0x00,0x00,0x00,0x00,0x00,0x00,0x00,0x00,0x00,0x00,
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  0x00,0x00,0x00,0x00,0x00,0x00,0x00,0x00,0x00,0x00,0x00,0x00,0x00,0x00,0x00,0x00
};

// ---------- OBRA 2: Abstracto ----------
const unsigned char obra2[] PROGMEM = {
  0x80,0x00,0x00,0x00,0x00,0x00,0x00,0x00,0x00,0x00,0x00,0x00,0x00,0x00,0x00,0x00,
  0x60,0x00,0x00,0x00,0x00,0x00,0x00,0x00,0x00,0x00,0x00,0x00,0x00,0x00,0x00,0x00,
  0x18,0x00,0x00,0x00,0x00,0x00,0x00,0x00,0x00,0x00,0x00,0x00,0x00,0x00,0x00,0x00,
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  0x00,0x00,0x00,0x00,0x00,0x00,0x00,0x00,0x00,0x00,0x00,0x00,0x00,0x00,0x00,0x06
};

// ---------- OBRA 3: Retrato ----------
const unsigned char obra3[] PROGMEM = {
  0x00,0x00,0x00,0x00,0x00,0x00,0x00,0x00,0x00,0x00,0x00,0x00,0x00,0x00,0x00,0x00,
  0x00,0x00,0x00,0x00,0x00,0x00,0x00,0x00,0x00,0x00,0x00,0x00,0x00,0x00,0x00,0x00,
  0x00,0x00,0x00,0x00,0x00,0x00,0x00,0x00,0x00,0x00,0x00,0x00,0x00,0x00,0x00,0x00,
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  0x00,0x00,0x00,0x00,0x00,0x00,0x00,0x00,0x00,0x00,0x00,0x00,0x00,0x00,0x00,0x00
};

// ---------- PAGINA WEB (chatbot servido por el ESP32) ----------
const char paginaHTML[] PROGMEM = R"rawliteral(
<!DOCTYPE html>
<html lang="es">
<head>
<meta charset="UTF-8">
<meta name="viewport" content="width=device-width, initial-scale=1.0">
<title>Chatbot Sala Inteligente</title>
<style>
  body { margin:0; background:#1b1917; font-family:sans-serif; color:#f2e9dc; display:flex; flex-direction:column; height:100vh; }
  h1 { font-size:20px; padding:16px; margin:0; border-bottom:1px solid #3a352f; }
  .chat { flex:1; overflow-y:auto; padding:16px; display:flex; flex-direction:column; gap:10px; }
  .burbuja { max-width:75%; padding:10px 14px; border-radius:14px; font-size:14px; }
  .bot { align-self:flex-start; background:#24211e; border:1px solid #3a352f; }
  .usuario { align-self:flex-end; background:#e8a33d; color:#2a1f0d; font-weight:bold; }
  .error { align-self:flex-start; background:#3a1f1a; color:#c4634f; border:1px solid #c4634f; }
  .sugerencias { display:flex; gap:8px; flex-wrap:wrap; padding:0 16px 10px; }
  .chip { background:#24211e; border:1px solid #3a352f; color:#b8ada0; border-radius:999px; padding:8px 14px; font-size:13px; }
  .entrada { display:flex; gap:8px; padding:12px 16px 20px; border-top:1px solid #3a352f; }
  .entrada input { flex:1; background:#17150f; border:1px solid #3a352f; border-radius:20px; padding:12px 16px; color:#f2e9dc; font-size:15px; }
  .entrada button { background:#e8a33d; border:none; color:#2a1f0d; border-radius:50%; width:44px; height:44px; font-size:18px; font-weight:bold; }
</style>
</head>
<body>
  <h1>Asistente de Sala</h1>
  <div class="chat" id="chat">
    <div class="burbuja bot">Hola, puedo controlar la luz, la persiana y el cuadro. Dime que necesitas.</div>
  </div>
  <div class="sugerencias">
    <div class="chip" onclick="enviarTexto('enciende la luz')">Enciende la luz</div>
    <div class="chip" onclick="enviarTexto('apaga la luz')">Apaga la luz</div>
    <div class="chip" onclick="enviarTexto('abre la persiana')">Abre persiana</div>
    <div class="chip" onclick="enviarTexto('cierra la persiana')">Cierra persiana</div>
    <div class="chip" onclick="enviarTexto('cambia el cuadro')">Cambiar cuadro</div>
  </div>
  <div class="entrada">
    <input id="msg" type="text" placeholder="Escribe o dicta tu mensaje...">
    <button onclick="enviarTexto()">Enviar</button>
  </div>
<script>
  const chat = document.getElementById('chat');
  const msg = document.getElementById('msg');
  const reglas = [
    { patron: /(prend|encend|enciend).*luz|luz.*(prend|encend|enciend)/, comando: 'luz_on', ok: 'Listo, encendi la luz' },
    { patron: /apag.*luz|luz.*apag/, comando: 'luz_off', ok: 'Listo, apague la luz' },
    { patron: /abr.*persiana|persiana.*abr/, comando: 'persiana_abrir', ok: 'Abriendo la persiana' },
    { patron: /(cerr|cierr).*persiana|persiana.*(cerr|cierr)/, comando: 'persiana_cerrar', ok: 'Cerrando la persiana' },
    { patron: /(siguiente|cambia|otro).*cuadro|cuadro.*(siguiente|cambia|otro)/, comando: 'cuadro_siguiente', ok: 'Cambiando el cuadro' },
  ];
  function burbuja(texto, tipo) {
    const d = document.createElement('div');
    d.className = 'burbuja ' + tipo;
    d.textContent = texto;
    chat.appendChild(d);
    chat.scrollTop = chat.scrollHeight;
  }
  async function enviarTexto(forzado) {
    const texto = (forzado !== undefined ? forzado : msg.value).trim();
    if (!texto) return;
    burbuja(texto, 'usuario');
    msg.value = '';
    const r = reglas.find(x => x.patron.test(texto.toLowerCase()));
    if (!r) { burbuja('No entendi ese comando.', 'error'); return; }
    try {
      await fetch('/comando?accion=' + r.comando);
      burbuja(r.ok, 'bot');
    } catch(e) {
      burbuja('Error de conexion con el ESP32', 'error');
    }
  }
  msg.addEventListener('keydown', e => { if (e.key === 'Enter') enviarTexto(); });
</script>
</body>
</html>
)rawliteral";

void setup() {
  Serial.begin(115200);

  // Luz
  pinMode(PIN_LUZ, OUTPUT);
  digitalWrite(PIN_LUZ, LOW);

  // Servo (persiana)
  ledcAttach(PIN_SERVO, 50, 16);
  moverServo(anguloCerrada);

  // Piano
  for (int i = 0; i < 7; i++) {
    pinMode(teclas[i], INPUT_PULLUP);
  }
  ledcAttach(pinBuzzer, 2000, 8);

  // OLED
  if (!display.begin(SSD1306_SWITCHCAPVCC, 0x3C)) {
    Serial.println("Error: no se detecta la pantalla OLED");
  } else {
    mostrarCuadro(cuadroActual);
  }

  // WiFi
  WiFi.begin(ssid, password);
  Serial.print("Conectando a WiFi");
  int intentos = 0;
  while (WiFi.status() != WL_CONNECTED && intentos < 40) {
    delay(500);
    Serial.print(".");
    intentos++;
  }
  if (WiFi.status() == WL_CONNECTED) {
    Serial.println();
    Serial.print("Conectado. Abre esta direccion en Safari: http://");
    Serial.println(WiFi.localIP());
  } else {
    Serial.println();
    Serial.println("NO SE PUDO CONECTAR AL WIFI.");
  }

  server.on("/", handleRoot);
  server.on("/comando", manejarComando);
  server.begin();
  Serial.println("Servidor HTTP iniciado");
}

void loop() {
  server.handleClient();
  revisarPiano();
}

// ---------- FUNCIONES ----------

void handleRoot() {
  server.send(200, "text/html", paginaHTML);
}

void moverServo(int angulo) {
  int pulso = map(angulo, 0, 360, 500, 2500);
  int duty = (pulso * 65536) / 20000;
  ledcWrite(PIN_SERVO, duty);
}

void manejarComando() {
  if (!server.hasArg("accion")) {
    server.send(400, "text/plain", "Falta parametro 'accion'");
    return;
  }
  String accion = server.arg("accion");
  accion.toLowerCase();
  String respuesta = "OK";

  if (accion == "luz_on") {
    luzEncendida = true;
    digitalWrite(PIN_LUZ, HIGH);
    respuesta = "Luz encendida";
  }
  else if (accion == "luz_off") {
    luzEncendida = false;
    digitalWrite(PIN_LUZ, LOW);
    respuesta = "Luz apagada";
  }
  else if (accion == "persiana_abrir") {
    moverServo(anguloAbierta);
    persianaAbierta = true;
    respuesta = "Persiana abierta";
  }
  else if (accion == "persiana_cerrar") {
    moverServo(anguloCerrada);
    persianaAbierta = false;
    respuesta = "Persiana cerrada";
  }
  else if (accion == "cuadro_siguiente") {
    cuadroActual = (cuadroActual + 1) % totalCuadros;
    mostrarCuadro(cuadroActual);
    respuesta = "Cuadro cambiado";
  }
  else {
    respuesta = "Comando no reconocido: " + accion;
    server.send(404, "text/plain", respuesta);
    return;
  }
  Serial.println(respuesta);
  server.send(200, "text/plain", respuesta);
}

void revisarPiano() {
  bool algoSonando = false;
  for (int i = 0; i < 7; i++) {
    if (digitalRead(teclas[i]) == LOW) {
      ledcWriteTone(pinBuzzer, notas[i]);
      algoSonando = true;
      break;
    }
  }
  if (!algoSonando) {
    ledcWriteTone(pinBuzzer, 0);
  }
}

void mostrarCuadro(int indice) {
  display.clearDisplay();
  switch (indice) {
    case 0: display.drawBitmap(0, 0, obra1, 128, 64, SSD1306_WHITE); break;
    case 1: display.drawBitmap(0, 0, obra2, 128, 64, SSD1306_WHITE); break;
    case 2: display.drawBitmap(0, 0, obra3, 128, 64, SSD1306_WHITE); break;
  }
  display.display();
}